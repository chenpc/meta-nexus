## conf/bblayers.conf
```bitbake
# POKY_BBLAYERS_CONF_VERSION is increased each time build/conf/bblayers.conf
# changes incompatibly
POKY_BBLAYERS_CONF_VERSION = "2"

BBPATH = "${TOPDIR}"
BBFILES ?= ""

BBLAYERS ?= " \
  /home/chenpc/git/nexus/yocto/poky/meta \
  /home/chenpc/git/nexus/yocto/poky/meta-poky \
  /home/chenpc/git/nexus/yocto/poky/meta-selftest \
  /home/chenpc/git/nexus/yocto/poky/meta-yocto-bsp \
  /home/chenpc/git/nexus/yocto/meta-nexus \
  "
```

## conf/layer.conf
```bitbake
# Layer configuration for meta-nexus
BBPATH .= ":${LAYERDIR}"

BBFILES += " \
    ${LAYERDIR}/recipes-*/*/*.bb \
    ${LAYERDIR}/recipes-*/*/*.bbappend \
"

BBFILE_COLLECTIONS += "meta-nexus"
BBFILE_PATTERN_meta-nexus = "^${LAYERDIR}/"
BBFILE_PRIORITY_meta-nexus = "6"

LAYERDEPENDS_meta-nexus = "core"
LAYERSERIES_COMPAT_meta-nexus = "scarthgap whinlatter"
```
